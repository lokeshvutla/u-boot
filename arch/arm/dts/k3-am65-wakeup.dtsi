// SPDX-License-Identifier: GPL-2.0
/*
 * Device Tree Source for AM6 SoC Family Wakeup Domain peripherals
 *
 * Copyright (C) 2016-2018 Texas Instruments Incorporated - http://www.ti.com/
 */

&cbass_wakeup {
	wkup_pmx0: pinmux@4301c000 {
		compatible = "pinctrl-single";
		reg = <0x4301c000 0x118>;
		#pinctrl-cells = <1>;
		pinctrl-single,register-width = <32>;
		pinctrl-single,function-mask = <0xffffffff>;
	};

	wkup_uart0: serial@42300000 {
		compatible = "ti,am654-uart", "ti,omap4-uart", "ns16550a";
		reg = <0x42300000 0x100>;
		reg-shift = <2>;
		reg-io-width = <4>;
		interrupts = <GIC_SPI 697 IRQ_TYPE_LEVEL_HIGH>;
		clock-frequency = <48000000>;
		current-speed = <115200>;
		status = "disabled";
	};

};
